#include <Arduino.h>
#include <WiFi.h>
#include <esp_ota_ops.h>
#include <esp_sleep.h>
#include "mqtt/mqtt.h"
#include "led/led.h"
#include "ota/ota.h"
#include "shadow/shadow.h"
#include "wdt/wdt.h"
#include "tools/tools.h"
#include "net/net.h"
#include "button/button.h"
#include "driver/rtc_io.h"
#include "version.h"

// ═══════════════════════════════════════════════════════════
// ПАМʼЯТЬ, ЩО ПЕРЕЖИВАЄ СОН (Заняття 16)
//
// RTC_DATA_ATTR кладе змінну у 8 КБ RTC-памʼяті — єдине, що лишається
// під живленням у Deep Sleep. Правила жорсткі: тільки глобальні або
// static, тільки прості типи. Ініціалізація нижче виконується ЛИШЕ
// при подачі живлення, після пробудження — ні.
//
// RTC RAM живе МІЖ ПРОБУДЖЕННЯМИ. Витягли живлення або RESET — чисто.
// Щоб пережити вимкнення, потрібна NVS (Заняття 17).
// ═══════════════════════════════════════════════════════════
RTC_DATA_ATTR int  bootCount    = 0;
RTC_DATA_ATTR int  sleepSeconds = 60;
RTC_DATA_ATTR char indicator[8] = "on";   // чи світитись під час роботи

#define WAIT_JOB_MS     2000   // скільки чекаємо відповідь про роботу
#define WAIT_SHADOW_MS  2000   // скільки чекаємо дельту тіні

bool errorMessagePrinted = false;
// ═══════════════════════════════════════════════════════════
// ПІДТВЕРДЖЕННЯ ОБРАЗУ: «я не просто завантажився — я працюю»
//
// Записати прошивку у флеш — ще не означає оновитись. Ядро зібране
// з CONFIG_BOOTLOADER_APP_ROLLBACK_ENABLE=y, а це вмикає в
// завантажувачі випробувальний термін для кожного нового образу:
//
//   Update.end(true)      → слот стає NEW
//   завантажувач          → бачить NEW, ставить PENDING_VERIFY і запускає
//   підтвердження         → VALID, образ прийнято назавжди
//   ресет до підтвердження → ABORTED, слот викреслено, вантажимо старий
//
// ПАСТКА: Arduino за замовчуванням підтверджує образ САМ — ще до setup(),
// у initArduino(). Тобто «дожив до setup()» = «прийнято назавжди».
// Rollback тоді рятує лише від прошивки, що падає на старті. Прошивка, яка
// стартує, але не може підключитись, буде підтверджена — і пристрій у
// серверній чи на даху більше ніколи не отримає наступне OTA.
//
// Тому забираємо рішення собі: verifyRollbackLater() повертає true —
// «не підтверджуй, я вирішу сам». Доказ життя тут — підключення до MQTT:
// саме через MQTT приходить наступне оновлення.
//
// extern "C" обовʼязковий: ядро оголошує цю функцію в C-файлі як «слабку»
// (weak). Без extern "C" компілятор C++ дасть їй інше імʼя, ядро її не
// побачить і мовчки підтвердить образ саме — жодної помилки не буде.
// ═══════════════════════════════════════════════════════════
extern "C" bool verifyRollbackLater() {
    return true;
}
// ═══════════════════════════════════════════════════════════
// СОН. Виноситься в функцію, бо викликається з трьох місць:
// нормальне завершення циклу, відсутність мережі, збій MQTT.
//
// Пристрій, який не зміг підключитись, МУСИТЬ заснути. Інакше він
// лишиться в активному режимі на 160 мА і висадить батарею за добу,
// нічого при цьому не роблячи. Невдача — теж привід спати.
// ═══════════════════════════════════════════════════════════

static void go_to_sleep() {

    if (otaInProgress) {
        Serial.println("[SLEEP] Йде OTA — не спимо");
        return;
    }

    // Гасимо індикацію ДО фінального друку — цей виклик логує в Serial,
    // а після flush() друкувати вже не можна.
    led_set("off");
    

    // ═══ ЗАКРИВАЄМО МЕРЕЖУ ═══
    // Wi-Fi драйвер має власні задачі й переривання. Іти в сон
    // з живим радіо — напрошуватись на проблеми при вході в критичну
    // секцію. Плюс це просто правильно енергетично: радіо має згаснути.
    mqtt_disconnect_for_ota();   // DISCONNECT + net.stop()
    WiFi.mode(WIFI_OFF);         // esp_wifi_stop() усередині — цього досить

    // Драйверу Wi-Fi треба кілька десятків мілісекунд, щоб згорнути
    // свої задачі. Заходити в критичну секцію сну раніше — просити біди.
    delay(100);

    Serial.print("[SLEEP] Засинаємо на ");
    Serial.print(sleepSeconds);
    Serial.println(" с");

    // ОСТАННІЙ РЯДОК ПЕРЕД СНОМ. Після flush() друкувати вже не можна:
    // байти, що лишились у TX-буфері UART, у сон не поїдуть.
    Serial.flush();

    // Без цього рядка сну в Wokwi не буде: симулятор зупиняє ЦП, але
    // таймери групи продовжують рахувати, і watchdog робить ресет
    // замість пробудження. На залізі виклик нічого не змінює.
    // Розбір, чому саме так, — у src/wdt/wdt.cpp.
    wdt_silence_for_sleep();

    // Оці три рядки і є Deep Sleep: керування сюди більше не
    // повертається, а через sleepSeconds або по натисканню кнопки чіп стартує з нуля —
    // з новим setup() і з живою RTC-памʼяттю.
       
    esp_sleep_enable_ext0_wakeup(BUTTON_PIN, 0); // Вихід зі сну по натисканню кнопки.
    esp_sleep_enable_timer_wakeup((uint64_t)sleepSeconds * 1000000ULL);
    esp_deep_sleep_start();
}



void handle_wakeup_reason(){
  esp_sleep_wakeup_cause_t wakeup_reason;

  wakeup_reason = esp_sleep_get_wakeup_cause();

  switch(wakeup_reason)
  {
    case ESP_SLEEP_WAKEUP_EXT0 :
    { 
      Serial.println("Пробудження по кнопці (EXT0)"); 
      buttonPressed = true;
      break;
    }   
    case ESP_SLEEP_WAKEUP_EXT1 : Serial.println("Пробудження по RTC_CNTL"); break;
    case ESP_SLEEP_WAKEUP_TIMER : Serial.println("Пробудження по таймеру"); break;
    case ESP_SLEEP_WAKEUP_TOUCHPAD : Serial.println("Пробудження по тачпаду"); break;
    case ESP_SLEEP_WAKEUP_ULP : Serial.println("Пробудження по ULP"); break;
    default : Serial.printf("Пробудження не з Deep Sleep : %d\n",wakeup_reason); break;
  }
}

// ═══════════════════════════════════════════════════════════
// ОДНЕ ПРОБУДЖЕННЯ = ОДИН ПРОХІД ЦІЄЇ ФУНКЦІЇ.
//
// setup() викликає її рівно раз: у кінці ми засинаємо, а пробудження —
// це новий старт з нуля, тобто новий setup().
//
// Окремо від setup() вона живе через єдиний виняток: якщо йде OTA,
// заснути не можна, і цикл доводиться повторювати з loop().
// ═══════════════════════════════════════════════════════════
static void work_cycle() {
    bootCount++;

    // Три числа, які розрізняють усі сценарії OTA за одну секунду:
    //   розділ app1 + причина 8 (DEEPSLEEP) → оновились, усе добре
    //   розділ app0 після оновлення        → відкотились
    //   причина 5 (INT_WDT) / 6 (TASK_WDT) → watchdog під час запису
    // Коди: 1 POWERON, 3 SW, 4 PANIC, 5 INT_WDT, 6 TASK_WDT, 8 DEEPSLEEP
    //
    // УВАГА: причина 8 тепер неоднозначна. Раніше DEEPSLEEP означав
    // «щойно завершився OTA» (ми будили пристрій зі сну замість
    // ESP.restart()). Тепер це ще й звичайне пробудження за таймером.
    // Розрізняти — по розділу і bootCount.
    Serial.printf("ESP32 — версія %s, розділ %s, причина ресету %d, пробудження %d\n",
                  FIRMWARE_VERSION,
                  esp_ota_get_running_partition()->label,
                  (int)esp_reset_reason(),
                  bootCount);

    
    handle_wakeup_reason();                  
    // ── ВІДНОВЛЮЄМО ФАКТИЧНИЙ СТАН ──
    // Deep Sleep знеструмлює GPIO — світлодіод гасне сам собою.
    // Якщо цього не зробити, вийде брехня: у reported тіні написано
    // "on", а лампочка фізично не горить. AWS не побачить різниці
    // (desired == reported) і дельту не надішле — світло вже ніколи
    // не увімкнеться. Тінь має відповідати реальності, а реальність
    // після сну треба відтворювати руками.
    // led_set("Off");

    // ── 1-2. Мережа, час, TLS, MQTT + підписки ──
    if (!mqtt_begin_retry(1000, 30000)) {
        Serial.println("[MAIN] Мережа недоступна — спимо до наступної спроби");
        go_to_sleep();
        return;
    }

    if (!mqtt_connect_retry(1000, 30000)) {
        Serial.println("[MAIN] MQTT не підключився — спимо до наступної спроби");
        go_to_sleep();
        return;
    }
     
    // Якщо вихід з DeepSleep був через кнопку, публікуємо подію. 
    if(buttonPressed)
    {
        buttonPressed = false;
        mqtt_publish_event(BUTTON_EVENT, 1);
    }
    
    
    // ──  Який стан має бути? ──
    // Ось відповідь на проблему, яку ми створили сном: команда — це
    // подія, вона губиться, поки ми спимо. Тінь — це стан, вона лежить
    // і чекає. Пристрій сам приходить і питає.
    shadow_request();
    shadow_wait_for_delta(WAIT_SHADOW_MS);

    ShadowDelta delta;
    if (shadow_take_delta(&delta)) {

        if (delta.hasIndicator) {
            strncpy(indicator, delta.indicator, sizeof(indicator) - 1);
            indicator[sizeof(indicator) - 1] = '\0';
            led_set(indicator);
        }

        if (delta.hasInterval) {
            sleepSeconds = delta.interval;
            Serial.print("[MAIN] Новий інтервал сну: ");
            Serial.println(sleepSeconds);
        }

        shadow_report(indicator, sleepSeconds);
    }

     

    // ═══════════════════════════════════════════════════════════
    // ПІДТВЕРДЖУЄМО ОБРАЗ: «я завантажився і працюю»
    //
    // Тепер це КРИТИЧНІШЕ, ніж було. Ядро зібране з
    // CONFIG_BOOTLOADER_APP_ROLLBACK_ENABLE=y: новий образ отримує
    // випробувальний термін, і будь-який ресет до підтвердження
    // означає ABORTED — слот викреслюється назавжди.
    //
    // А пробудження з Deep Sleep — це РЕСЕТ. Тобто якщо не підтвердити
    // образ ДО сну, пристрій прокинеться вже на старій прошивці,
    // і зрозуміти чому буде важко: помилки не буде ніде.
    //
    // Критерій життя тут: дійшли до цього рядка, тобто Wi-Fi піднявся,
    // час синхронізовано, MQTT підключено. Для реального пристрою можна
    // суворіше — наприклад, після першої вдалої публікації телеметрії.
    // Але памʼятайте: занадто суворий критерій відкочує робочі оновлення.
    // ═══════════════════════════════════════════════════════════
    esp_ota_mark_app_valid_cancel_rollback();

    


    // ── 3. Чи є оновлення? ──
    // Запит уже опублікований усередині mqtt_connect(). Тут ми даємо
    // відповіді шанс приїхати: крутимо poll, поки не прийде або
    // не вийде час. delay() тут не спрацював би — він не читає сокет.
    mqtt_wait_for_job(WAIT_JOB_MS);
    
  
    const char* job = mqtt_take_job();
    if (job) {
        // Синхронно: качаємо і пишемо прямо тут.
        //   успіх   → перезавантаження всередині, сюди не повернемось
        //   невдача → повернемось, otaInProgress уже знято
        ota_handle_job(job);
    }

    
    // ── 4. Віддали вимір ──
    // Поки що випадкові числа. Реальні DHT22 і фоторезистор — ваша
    // частина в курсовому.

      DHTTData dhttData;
      LDRData ldrData;                
      if(read_sensors(&ldrData, &dhttData))
      {
            mqtt_publish_telemetry(dhttData.temperature, dhttData.humidity, ldrData.lux);      
      }  

   
    // ── Команда з Заняття 14 ──
    // Могла прилетіти, поки ми крутили poll в очікуваннях вище.
    // Чесне обмеження: доходить лише якщо її опублікували саме
    // в це вузьке вікно. Все, що надіслали під час сну — втрачено.
    // Саме тому надійне керування живе в тіні, а не в командах.
    const char* cmd = mqtt_take_command();
    if (cmd) {
        led_handle_command(cmd);
    }

    // ── 6. Спати ──
    shadow_report("off", sleepSeconds); // Звітуємо стан перед сном, щоб тінь знала, LED вимкнено.
    go_to_sleep();
}

// ═══════════════════════════════════════════════════════════
// Тут лишається тільки те, що робиться РІВНО ОДИН РАЗ за вмикання:
// UART і пін світлодіода. Усе інше — робота одного пробудження.
// ═══════════════════════════════════════════════════════════
void setup() {
   
    Serial.begin(115200);     
    delay(500);

    led_begin();
    ldr_begin();
    dht_begin();
    button_begin();
       
    work_cycle();
}

// ═══════════════════════════════════════════════════════════
// Майже завжди недосяжний: esp_deep_sleep_start() не повертає
// керування, а пробудження стартує з setup().
//
// Єдиний шлях сюди — go_to_sleep() вийшла без сну, бо йде OTA.
// Раніше це означало смерть: setup() завершувався, loop() був
// порожній, і пристрій лишався в активному режимі на 160 мА
// НАЗАВЖДИ. Тому тут не заглушка, а спроба заснути далі.
// ═══════════════════════════════════════════════════════════
void loop() {

  if (otaInProgress) {
        mqtt_poll();
        delay(1000);
        return;
    }
  
    work_cycle();
}
     